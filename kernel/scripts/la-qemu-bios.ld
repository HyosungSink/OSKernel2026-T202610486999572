OUTPUT_ARCH(loongarch)
ENTRY(_start)

SECTIONS {
  . = 0x1c000000;
  .text : { *(.text .text.*) }
  .rodata : { *(.rodata .rodata.*) }
  .data : { *(.data .data.*) }
  .bss : { *(.bss .bss.*) *(COMMON) }
}
